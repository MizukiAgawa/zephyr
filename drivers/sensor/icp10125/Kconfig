## drivers/sensor/icp10125/Kconfig
```kconfig
# ICP10125 temperature and pressure sensor configuration options

# Copyright (c) 2022 Mizuki AGAWA <agawa.mizuki@fujitsu.com>
# SPDX-License-Identifier: Apache-2.0

menuconfig ICP10125
	bool "ICP10125 sensor"
	help
	  Enable driver for ICP10125 temperature and pressure sensor.

if ICP10125

config ICP10125_CRC_CHECK
	bool "Enable CRC Check"
	default y
	help
	  Check the crc of measument data.

endif # ICP10125
```

## drivers/sensor/icp10125/Kconfig.bak
```kconfig
# BMP280 temperature and pressure sensor configuration options

# Copyright (c) 2016 Intel Corporation
# Copyright (c) 2017 IpTronix S.r.l.
# SPDX-License-Identifier: Apache-2.0

menuconfig PIM586
	bool "PIM586 sensor"
	depends on I2C || SPI
	help
	  Enable driver for PIM586 I2C-based or SPI-based temperature and pressure sensor.

if PIM586

choice
	prompt "PIM586 sampling mode"
	default PIM586_MODE_NORMAL
	help
	  Select sampling mode. In normal mode continuous measurements are
	  performed, whereas in forced mode only single measurement is performed.
config PIM586_MODE_NORMAL
	bool "normal"
config PIM586_MODE_FORCED
	bool "forced"
endchoice

choice
	prompt "PIM586 temperature oversampling"
	default PIM586_TEMP_OVER_2X
	help
	  Select temperature oversampling for the PIM586 sensor.  Higher values
	  lead to more accurate readings, but higher power consumption.
config PIM586_TEMP_OVER_1X
	bool "x1"
config PIM586_TEMP_OVER_2X
	bool "x2"
config PIM586_TEMP_OVER_4X
	bool "x4"
config PIM586_TEMP_OVER_8X
	bool "x8"
config PIM586_TEMP_OVER_16X
	bool "x16"
endchoice

choice
	prompt "PIM586 pressure oversampling"
	default PIM586_PRESS_OVER_16X
	help
	  Select pressure oversampling for the PIM586 sensor.  Higher values
	  lead to more accurate readings, but higher power consumption.
config PIM586_PRESS_OVER_1X
	bool "x1"
config PIM586_PRESS_OVER_2X
	bool "x2"
config PIM586_PRESS_OVER_4X
	bool "x4"
config PIM586_PRESS_OVER_8X
	bool "x8"
config PIM586_PRESS_OVER_16X
	bool "x16"
endchoice

choice
	prompt "PIM586 humidity oversampling"
	default PIM586_HUMIDITY_OVER_16X
	help
	  Select humidity oversampling for the PIM586 sensor.  Higher values
	  lead to more accurate readings, but higher power consumption.
config PIM586_HUMIDITY_OVER_1X
	bool "x1"
config PIM586_HUMIDITY_OVER_2X
	bool "x2"
config PIM586_HUMIDITY_OVER_4X
	bool "x4"
config PIM586_HUMIDITY_OVER_8X
	bool "x8"
config PIM586_HUMIDITY_OVER_16X
	bool "x16"
endchoice

choice
	prompt "PIM586 standby time"
	default PIM586_STANDBY_1000MS
	help
	  Select standby time between measurements for the PIM586 sensor.
	  Higher values lead to lower power consumption.
config PIM586_STANDBY_05MS
	bool "0.5ms"
config PIM586_STANDBY_62MS
	bool "62.5ms"
config PIM586_STANDBY_125MS
	bool "125ms"
config PIM586_STANDBY_250MS
	bool "250ms"
config PIM586_STANDBY_500MS
	bool "500ms"
config PIM586_STANDBY_1000MS
	bool "1000ms"
config PIM586_STANDBY_2000MS
	bool "2000ms BMP280 / 10ms PIM586"
config PIM586_STANDBY_4000MS
	bool "4000ms BMP280 / 20ms PIM586"
endchoice

choice
	prompt "PIM586 filter coefficient"
	default PIM586_FILTER_4
	help
	  Select the filter coefficient for the PIM586 sensor.
config PIM586_FILTER_OFF
	bool "filter off"
config PIM586_FILTER_2
	bool "2"
config PIM586_FILTER_4
	bool "4"
config PIM586_FILTER_8
	bool "8"
config PIM586_FILTER_16
	bool "16"
endchoice

endif # PIM586
```

## drivers/sensor/si1145/Kconfig
```kconfig
# BMP280 temperature and pressure sensor configuration options

# Copyright (c) 2016 Intel Corporation
# Copyright (c) 2017 IpTronix S.r.l.
# SPDX-License-Identifier: Apache-2.0

menuconfig SI1145
	bool "SI1145/BMP280 sensor"
	depends on I2C || SPI
	help
	  Enable driver for SI1145 I2C-based or SPI-based temperature and pressure sensor.

if SI1145

choice
	prompt "SI1145 sampling mode"
	default SI1145_MODE_NORMAL
	help
	  Select sampling mode. In normal mode continuous measurements are
	  performed, whereas in forced mode only single measurement is performed.
config SI1145_MODE_NORMAL
	bool "normal"
config SI1145_MODE_FORCED
	bool "forced"
endchoice

choice
	prompt "SI1145 temperature oversampling"
	default SI1145_TEMP_OVER_2X
	help
	  Select temperature oversampling for the SI1145 sensor.  Higher values
	  lead to more accurate readings, but higher power consumption.
config SI1145_TEMP_OVER_1X
	bool "x1"
config SI1145_TEMP_OVER_2X
	bool "x2"
config SI1145_TEMP_OVER_4X
	bool "x4"
config SI1145_TEMP_OVER_8X
	bool "x8"
config SI1145_TEMP_OVER_16X
	bool "x16"
endchoice

choice
	prompt "SI1145 pressure oversampling"
	default SI1145_PRESS_OVER_16X
	help
	  Select pressure oversampling for the SI1145 sensor.  Higher values
	  lead to more accurate readings, but higher power consumption.
config SI1145_PRESS_OVER_1X
	bool "x1"
config SI1145_PRESS_OVER_2X
	bool "x2"
config SI1145_PRESS_OVER_4X
	bool "x4"
config SI1145_PRESS_OVER_8X
	bool "x8"
config SI1145_PRESS_OVER_16X
	bool "x16"
endchoice

choice
	prompt "SI1145 humidity oversampling"
	default SI1145_HUMIDITY_OVER_16X
	help
	  Select humidity oversampling for the SI1145 sensor.  Higher values
	  lead to more accurate readings, but higher power consumption.
config SI1145_HUMIDITY_OVER_1X
	bool "x1"
config SI1145_HUMIDITY_OVER_2X
	bool "x2"
config SI1145_HUMIDITY_OVER_4X
	bool "x4"
config SI1145_HUMIDITY_OVER_8X
	bool "x8"
config SI1145_HUMIDITY_OVER_16X
	bool "x16"
endchoice

choice
	prompt "SI1145 standby time"
	default SI1145_STANDBY_1000MS
	help
	  Select standby time between measurements for the SI1145 sensor.
	  Higher values lead to lower power consumption.
config SI1145_STANDBY_05MS
	bool "0.5ms"
config SI1145_STANDBY_62MS
	bool "62.5ms"
config SI1145_STANDBY_125MS
	bool "125ms"
config SI1145_STANDBY_250MS
	bool "250ms"
config SI1145_STANDBY_500MS
	bool "500ms"
config SI1145_STANDBY_1000MS
	bool "1000ms"
config SI1145_STANDBY_2000MS
	bool "2000ms BMP280 / 10ms SI1145"
config SI1145_STANDBY_4000MS
	bool "4000ms BMP280 / 20ms SI1145"
endchoice

choice
	prompt "SI1145 filter coefficient"
	default SI1145_FILTER_4
	help
	  Select the filter coefficient for the SI1145 sensor.
config SI1145_FILTER_OFF
	bool "filter off"
config SI1145_FILTER_2
	bool "2"
config SI1145_FILTER_4
	bool "4"
config SI1145_FILTER_8
	bool "8"
config SI1145_FILTER_16
	bool "16"
endchoice

endif # SI1145
```

## dts/bindings/sensor/pimoroni,pim586.yaml
```yaml
# Copyright (c) 2019, Linaro Limited
# SPDX-License-Identifier: Apache-2.0

description: PIM586 proximity/UV/ambient light sensor

compatible: "silabs,pim586"

include: i2c-device.yaml
```

## dts/bindings/sensor/silabs,si1145.yaml
```yaml
# Copyright (c) 2019, Linaro Limited
# SPDX-License-Identifier: Apache-2.0

description: SI1145 proximity/UV/ambient light sensor

compatible: "silabs,si1145"

include: i2c-device.yaml
```

## dts/bindings/sensor/tdk,icp10125.yaml
```yaml
# Copyright (c) 2019, Linaro Limited
# SPDX-License-Identifier: Apache-2.0

description: ICP10125 temperature/pressure sensor

compatible: "tdk,icp10125"

include: i2c-device.yaml

properties:
    op-mode-temperature:
      type: string
      required: true
      description: Operating mode of sensor
      enum:
        - "low-power"
        - "normal"
        - "low-noise"
        - "ultra-low-noise"

    op-mode-pressure:
      type: string
      required: true
      description: Operating mode of sensor
      enum:
        - "low-power"
        - "normal"
        - "low-noise"
        - "ultra-low-noise"
```

## samples/sensor/pim586/sample.yaml
```yaml
sample:
  name: PIM586 Sensor sample
tests:
  sample.sensor.pim586:
    harness: console
    tags: sensors
    platform_allow: adafruit_feather_m0_basic_proto
    integration_platforms:
      - adafruit_feather_m0_basic_proto
    harness_config:
        type: one_line
        regex:
            - "temp: (.*); press: (.*); humidity: (.*)"
        fixture: fixture_i2c_pim586
  sample.sensor.pim586.spi:
    harness: console
    tags: sensors
    depends_on: spi pim586
    extra_args: "DTC_OVERLAY_FILE=arduino_spi.overlay"
    harness_config:
        type: one_line
        regex:
            - "temp: (.*); press: (.*); humidity: (.*)"
        fixture: fixture_spi_pim586
```
