/*
 * Copyright (c) 2020, Nordic Semiconductor ASA
 *
 * SPDX-License-Identifier: Apache-2.0
 */

/*
 * Example configuration of a PIM586 device on an Arduino I2C bus.
 *
 * Device address 0x77 is assumed. Your device may have a different
 * address; check your device documentation if unsure.
 */
&i2c0 {
	status = "okay";
	pim586@63 {
		compatible = "pimoroni,pim586";
		reg = <0x63>;
		label = "PIM586_I2C";
	};
};
