/*
 * Copyright (c) 2020, Nordic Semiconductor ASA
 *
 * SPDX-License-Identifier: Apache-2.0
 */

/* Example configuration of a BME280 device on an Arduino SPI bus. */

&spi1 {
	status = "okay";
	cs-gpios = <&gpio0 3 GPIO_ACTIVE_LOW>;
	bme280@0 {
		compatible = "bosch,bme280";
		reg = <0>;
		label = "BME280_SPI";
		spi-max-frequency = <1000000>; /* conservatively set to 1MHz */
	};
};
